## CMakeLists.txt
```
cmake_minimum_required(VERSION 3.13.1)
find_package(Zephyr REQUIRED HINTS $ENV{ZEPHYR_BASE})
project(spi_sid)

FILE(GLOB app_sources src/*.c)
target_sources(app PRIVATE ${app_sources})
```

## prj.conf
```kconfig
CONFIG_LOG=n
CONFIG_STDOUT_CONSOLE=n
CONFIG_PRINTK=n

CONFIG_USE_SEGGER_RTT=n
CONFIG_RTT_CONSOLE=n
CONFIG_UART_CONSOLE=n

CONFIG_SPI_1=y
CONFIG_SPI=y
CONFIG_SPI_STM32_INTERRUPT=n
CONFIG_SPI_STM32_DMA=n
CONFIG_SPI_STM32_USE_HW_SS=n

CONFIG_GPIO=y

CONFIG_DMA=n
CONFIG_DMA_STM32=n


CONFIG_ASSERT=n

CONFIG_DEBUG=n
CONFIG_OPENOCD_SUPPORT=y
CONFIG_DEBUG_INFO=y
CONFIG_EXCEPTION_STACK_TRACE=n
CONFIG_SPEED_OPTIMIZATIONS=y

CONFIG_ARM_MPU=n
```

## boards/nucleo_g474re.overlay
```dts
/*
 * Copyright (c) 2020 STMicroelectronics
 *
 * SPDX-License-Identifier: Apache-2.0
 */

&spi1 {
	status = "okay";

	dmas = <&dmamux1 0 11 0x20440 0
		&dmamux1 8 10 0x20480 0>;
	dma-names = "tx", "rx";

	cs-gpios = <&gpiob 6 GPIO_ACTIVE_LOW>;
};

&dma1 {
	status = "okay";
};

&dma2 {
	status = "okay";
};

&dmamux1 {
	status = "okay";
};
```

## src/main.c
```c
/*
 * Copyright (c) 2020 Erwin Rol <erwin@erwinrol.com
 *
 * SPDX-License-Identifier: GPL-2.0-or-later
 */

#include <errno.h>
#include <zephyr.h>
#include <sys/printk.h>
#include <device.h>
#include <drivers/spi.h>
#include <soc.h>
#include <stdint.h>

#include "c64.h"
#include "sid_spi.h"
#include "sid.h"
#include "sid_file.h"

volatile int n_refresh_cia;

K_TIMER_DEFINE(sid_timer, NULL, NULL);

void main(void)
{
  uint8_t status;
  uint8_t rd_data;

  if (sid_spi_init() < 0) {
    goto error_out;
  }

  for (uint8_t addr = 0; addr < 0x19; addr++) {
    sid_poke( addr, 0);
  }

  c64_init();

  struct sid_info info;
  sid_load_from_memory(sid_file, sid_file_size, &info);

  sid_poke(24, 15);
  c64_cpu_jsr(info.init_addr, 0);

  k_timer_start(&sid_timer, K_MSEC(20), K_MSEC(20));

  while (1) {
    k_timer_status_sync(&sid_timer);

    c64_cpu_jsr(info.play_addr, 0);

    n_refresh_cia = (int)(20000 * (c64_getmem(0xdc04) | (c64_getmem(0xdc05) << 8)) / 0x4c00);
  }

error_out:
  while(1) {
    k_sleep(K_MSEC(10));
  }
}
```

## src/c64.c
```c
/*
 * Copyright (c) 2020 Erwin Rol <erwin@erwinrol.com
 *
 * SPDX-License-Identifier: GPL-2.0-or-later
 *
 * This file was based on the rockbox sidplayer, which was based on the
 * tinysid engine.
 *
 ****************************************************************************
 *             __________               __   ___.
 *   Open      \______   \ ____   ____ |  | _\_ |__   _______  ___
 *   Source     |       _//  _ \_/ ___\|  |/ /| __ \ /  _ \  \/  /
 *   Jukebox    |    |   (  <_> )  \___|    < | \_\ (  <_> > <  <
 *   Firmware   |____|_  /\____/ \___  >__|_ \|___  /\____/__/\_ \
 *                     \/            \/     \/    \/            \/
 * $Id$
 *
 * SID Codec for rockbox based on the TinySID engine
 *
 * Written by Tammo Hinrichs (kb) and Rainer Sinsch in 1998-1999
 * Ported to rockbox on 14 April 2006
 *
 *
 * This program is free software; you can redistribute it and/or
 * modify it under the terms of the GNU General Public License
 * as published by the Free Software Foundation; either version 2
 * of the License, or (at your option) any later version.
 *
 * This software is distributed on an "AS IS" basis, WITHOUT WARRANTY OF ANY
 * KIND, either express or implied.
 *
 * kb explicitly points out that this emulation sounds crappy, though
 * we decided to put it open source so everyone can enjoy sidmusic
 * on rockbox
 *
 * v1.1
 * Added 16-04-2006: Rainer Sinsch
 * Removed all time critical floating point operations and
 * replaced them with quick & dirty integer calculations
 *
 * Added 17-04-2006: Rainer Sinsch
 * Improved quick & dirty integer calculations for the resonant filter
 * Improved audio quality by 4 bits
 *
 * v1.2
 * Added 17-04-2006: Dave Chapman
 * Improved file loading
 *
 * Added 17-04-2006: Rainer Sinsch
 * Added sample routines
 * Added cia timing routines
 * Added fast forwarding capabilities
 * Corrected bug in sid loading
 *
 * v1.2.1
 * Added 04-05-2006: Rainer Sinsch
 * Implemented Marco Alanens suggestion for subsong selection:
 * Select the subsong by seeking: Each second represents a subsong
 *
 */

#include "sid.h"

#include <stdint.h>
#include <string.h>
#include <stdlib.h>

#include "mos6510.h"

static struct mos6510 cpu;

static uint8_t bval;
static uint16_t wval;

static uint8_t memory[65536];

uint8_t c64_getmem(uint16_t addr)
{
    return memory[addr];
}

void c64_setmem(uint16_t addr, uint8_t value)
{
  if ((addr & 0xfc00) == 0xd400) {
    sid_poke(addr & 0x1f, value);
  } else {
    memory[addr] = value;
  }
}

static uint8_t getaddr(uint8_t mode)
{
  uint16_t ad,ad2;

  switch(mode) {
    case MOS6510_MODE_IMP:
        return 0;

    case MOS6510_MODE_IMM:
        return c64_getmem(cpu.pc++);

    case MOS6510_MODE_ABS:
        ad = c64_getmem(cpu.pc++);
        ad |= 256 * c64_getmem(cpu.pc++);
        return c64_getmem(ad);

    case MOS6510_MODE_ABSX:
        ad = c64_getmem(cpu.pc++);
        ad |= 256*c64_getmem(cpu.pc++);
        ad2 = ad + cpu.x;
        return c64_getmem(ad2);

    case MOS6510_MODE_ABSY:
        ad = c64_getmem(cpu.pc++);
        ad |= 256 * c64_getmem(cpu.pc++);
        ad2 = ad + cpu.y;
        return c64_getmem(ad2);

    case MOS6510_MODE_ZP:
        ad = c64_getmem(cpu.pc++);
        return c64_getmem(ad);

    case MOS6510_MODE_ZPX:
        ad = c64_getmem(cpu.pc++);
        ad += cpu.x;
        return c64_getmem(ad & 0xff);

    case MOS6510_MODE_ZPY:
        ad = c64_getmem(cpu.pc++);
        ad += cpu.y;
        return c64_getmem(ad & 0xff);

    case MOS6510_MODE_INDX:
        ad = c64_getmem(cpu.pc++);
        ad += cpu.x;
        ad2 = c64_getmem(ad&0xff);
        ad++;
        ad2 |= c64_getmem(ad & 0xff) << 8;
        return c64_getmem(ad2);

    case MOS6510_MODE_INDY:
        ad = c64_getmem(cpu.pc++);
        ad2 = c64_getmem(ad);
        ad2 |= c64_getmem((ad+1) & 0xff) << 8;
        ad = ad2 + cpu.y;
        return c64_getmem(ad);

    case MOS6510_MODE_ACC:
        return cpu.a;
  }

  return 0;
}

static void setaddr(uint8_t mode, uint8_t val)
{
  uint16_t ad,ad2;

  switch(mode)
  {
    case MOS6510_MODE_ABS:
      ad = c64_getmem(cpu.pc - 2);
      ad |= 256 * c64_getmem(cpu.pc - 1);
      c64_setmem(ad, val);
      return;

    case MOS6510_MODE_ABSX:
      ad = c64_getmem(cpu.pc-2);
      ad |= 256 * c64_getmem(cpu.pc - 1);
      ad2 = ad + cpu.x;
      c64_setmem(ad2, val);
      return;

    case MOS6510_MODE_ZP:
      ad = c64_getmem(cpu.pc - 1);
      c64_setmem(ad, val);
      return;

    case MOS6510_MODE_ZPX:
      ad = c64_getmem(cpu.pc - 1);
      ad += cpu.x;
      c64_setmem(ad & 0xff, val);
      return;

    case MOS6510_MODE_ACC:
      cpu.a = val;
      return;

  }
}


static void putaddr(uint8_t mode, uint8_t val)
{
  uint16_t ad,ad2;

  switch(mode)
  {
    case MOS6510_MODE_ABS:
      ad = c64_getmem(cpu.pc++);
      ad |= c64_getmem(cpu.pc++) << 8;
      c64_setmem(ad, val);
      return;

    case MOS6510_MODE_ABSX:
      ad = c64_getmem(cpu.pc++);
      ad |= c64_getmem(cpu.pc++) << 8;
      ad2 = ad+cpu.x;
      c64_setmem(ad2, val);
      return;

    case MOS6510_MODE_ABSY:
      ad = c64_getmem(cpu.pc++);
      ad |= c64_getmem(cpu.pc++) << 8;
      ad2 = ad + cpu.y;
      c64_setmem(ad2, val);
      return;

    case MOS6510_MODE_ZP:
      ad = c64_getmem(cpu.pc++);
      c64_setmem(ad, val);
      return;

    case MOS6510_MODE_ZPX:
      ad = c64_getmem(cpu.pc++);
      ad += cpu.x;
      c64_setmem(ad & 0xff, val);
      return;

    case MOS6510_MODE_ZPY:
      ad = c64_getmem(cpu.pc++);
      ad += cpu.y;
      c64_setmem(ad & 0xff, val);
      return;

    case MOS6510_MODE_INDX:
      ad = c64_getmem(cpu.pc++);
      ad += cpu.x;
      ad2 = c64_getmem(ad & 0xff);
      ad++;
      ad2 |= c64_getmem(ad & 0xff) << 8;
      c64_setmem(ad2, val);
      return;

    case MOS6510_MODE_INDY:
      ad = c64_getmem(cpu.pc++);
      ad2 = c64_getmem(ad);
      ad2 |= c64_getmem((ad + 1) & 0xff) << 8;
      ad = ad2 + cpu.y;
      c64_setmem(ad, val);
      return;

    case MOS6510_MODE_ACC:
      cpu.a = val;
      return;

  }
}

static void setflags(uint8_t flag, int cond)
{
  if (cond) {
    cpu.p |= flag;
  } else {
    cpu.p &= ~flag;
  }
}

static void push(uint8_t val)
{
  c64_setmem(0x100 + cpu.s, val);

  if (cpu.s) {
    cpu.s--;
  }
}

static uint8_t pop(void)
{
  if (cpu.s < 0xff) {
    cpu.s++;
  }

  return c64_getmem(0x100 + cpu.s);
}

static void branch(uint8_t flag)
{
    int8_t dist;

    dist = (int8_t)getaddr(MOS6510_MODE_IMM);

    wval = cpu.pc + dist;

    if (flag) {
      cpu.pc = wval;
    }
}

void c64_cpu_reset(void)
{
  cpu.a = 0x00;
  cpu.x = 0x00;
  cpu.y = 0x00;
  cpu.p = 0x00;
  cpu.s = 0xff;
  cpu.pc = 0xfffc;
}

void c64_cpu_reset_to(uint16_t new_pc, uint8_t new_a)
{
  cpu.a = new_a;
  cpu.x = 0x00;
  cpu.y = 0x00;
  cpu.p = 0x00;
  cpu.s = 0xff;
  cpu.pc = new_pc;
}

static void c64_cpu_step(void)
{
  int c;

  uint8_t opc = c64_getmem(cpu.pc++);
  uint8_t cmd = mos6510_opcode_table[opc].type;
  uint8_t addr = mos6510_opcode_table[opc].mode;

  switch (cmd)
  {
    case MOS6510_TYPE_ADC:
        wval = (uint16_t)cpu.a + getaddr(addr) + ((cpu.p & MOS6510_FLAG_C) ? 1 : 0);
        setflags(MOS6510_FLAG_C, wval & 0x100);
        cpu.a = (uint8_t)wval;
        setflags(MOS6510_FLAG_Z, !cpu.a);
        setflags(MOS6510_FLAG_N, cpu.a & 0x80);
        setflags(MOS6510_FLAG_V, (!!(cpu.p & MOS6510_FLAG_C)) ^ (!!(cpu.p & MOS6510_FLAG_N)));
        break;

    case MOS6510_TYPE_AND:
        bval = getaddr(addr);
        cpu.a &= bval;
        setflags(MOS6510_FLAG_Z, !cpu.a);
        setflags(MOS6510_FLAG_N, cpu.a & 0x80);
        break;

    case MOS6510_TYPE_ASL:
        wval = getaddr(addr);
        wval <<= 1;
        setaddr(addr,(uint8_t)wval);
        setflags(MOS6510_FLAG_Z, !wval);
        setflags(MOS6510_FLAG_N, wval & 0x80);
        setflags(MOS6510_FLAG_C, wval & 0x100);
        break;

    case MOS6510_TYPE_BCC:
        branch(!(cpu.p & MOS6510_FLAG_C));
        break;

    case MOS6510_TYPE_BCS:
        branch(cpu.p & MOS6510_FLAG_C);
        break;

    case MOS6510_TYPE_BNE:
        branch(!(cpu.p & MOS6510_FLAG_Z));
        break;

    case MOS6510_TYPE_BEQ:
        branch(cpu.p & MOS6510_FLAG_Z);
        break;

    case MOS6510_TYPE_BPL:
        branch(!(cpu.p & MOS6510_FLAG_N));
        break;

    case MOS6510_TYPE_BMI:
        branch(cpu.p & MOS6510_FLAG_N);
        break;

    case MOS6510_TYPE_BVC:
        branch(!(cpu.p & MOS6510_FLAG_V));
        break;

    case MOS6510_TYPE_BVS:
        branch(cpu.p & MOS6510_FLAG_V);
        break;

    case MOS6510_TYPE_BIT:
        bval = getaddr(addr);
        setflags(MOS6510_FLAG_Z, !(cpu.a & bval));
        setflags(MOS6510_FLAG_N, bval & 0x80);
        setflags(MOS6510_FLAG_V, bval & 0x40);
        break;

    case MOS6510_TYPE_BRK:
        cpu.pc = 0; /* Just quit the emulation */
        break;

    case MOS6510_TYPE_CLC:
        setflags(MOS6510_FLAG_C, 0);
        break;

    case MOS6510_TYPE_CLD:
        setflags(MOS6510_FLAG_D, 0);
        break;

    case MOS6510_TYPE_CLI:
        setflags(MOS6510_FLAG_I, 0);
        break;

    case MOS6510_TYPE_CLV:
        setflags(MOS6510_FLAG_V, 0);
        break;

    case MOS6510_TYPE_CMP:
        bval = getaddr(addr);
        wval = (uint16_t)cpu.a - bval;
        setflags(MOS6510_FLAG_Z, !wval);
        setflags(MOS6510_FLAG_N, wval & 0x80);
        setflags(MOS6510_FLAG_C, cpu.a >= bval);
        break;

    case MOS6510_TYPE_CPX:
        bval = getaddr(addr);
        wval = (uint16_t)cpu.x-bval;
        setflags(MOS6510_FLAG_Z, !wval);
        setflags(MOS6510_FLAG_N, wval & 0x80);
        setflags(MOS6510_FLAG_C, cpu.x >= bval);
        break;

    case MOS6510_TYPE_CPY:
        bval = getaddr(addr);
        wval = (uint16_t)cpu.y - bval;
        setflags(MOS6510_FLAG_Z, !wval);
        setflags(MOS6510_FLAG_N, wval & 0x80);
        setflags(MOS6510_FLAG_C, cpu.y >= bval);
        break;

    case MOS6510_TYPE_DEC:
        bval = getaddr(addr);
        bval--;
        setaddr(addr, bval);
        setflags(MOS6510_FLAG_Z, !bval);
        setflags(MOS6510_FLAG_N, bval & 0x80);
        break;

    case MOS6510_TYPE_DEX:
        cpu.x--;
        setflags(MOS6510_FLAG_Z, !cpu.x);
        setflags(MOS6510_FLAG_N, cpu.x & 0x80);
        break;

    case MOS6510_TYPE_DEY:
        cpu.y--;
        setflags(MOS6510_FLAG_Z, !cpu.y);
        setflags(MOS6510_FLAG_N, cpu.y & 0x80);
        break;

    case MOS6510_TYPE_EOR:
        bval = getaddr(addr);
        cpu.a ^= bval;
        setflags(MOS6510_FLAG_Z, !cpu.a);
        setflags(MOS6510_FLAG_N, cpu.a & 0x80);
        break;

    case MOS6510_TYPE_INC:
        bval = getaddr(addr);
        bval++;
        setaddr(addr, bval);
        setflags(MOS6510_FLAG_Z, !bval);
        setflags(MOS6510_FLAG_N, bval & 0x80);
        break;

    case MOS6510_TYPE_INX:
        cpu.x++;
        setflags(MOS6510_FLAG_Z, !cpu.x);
        setflags(MOS6510_FLAG_N, cpu.x & 0x80);
        break;

    case MOS6510_TYPE_INY:
        cpu.y++;
        setflags(MOS6510_FLAG_Z, !cpu.y);
        setflags(MOS6510_FLAG_N, cpu.y & 0x80);
        break;

    case MOS6510_TYPE_JMP:
        wval = c64_getmem(cpu.pc++);
        wval |= 256 * c64_getmem(cpu.pc++);
        switch (addr)
        {
            case MOS6510_MODE_ABS:
                cpu.pc = wval;
                break;

            case MOS6510_MODE_IND:
                cpu.pc = c64_getmem(wval);
                cpu.pc |= 256 * c64_getmem(wval + 1);
                break;
        }
        break;

    case MOS6510_TYPE_JSR:
        push((cpu.pc + 1) >> 8);
        push((cpu.pc + 1));
        wval = c64_getmem(cpu.pc++);
        wval |= 256 * c64_getmem(cpu.pc++);
        cpu.pc = wval;
        break;

    case MOS6510_TYPE_LDA:
        cpu.a = getaddr(addr);
        setflags(MOS6510_FLAG_Z, !cpu.a);
        setflags(MOS6510_FLAG_N, cpu.a & 0x80);
        break;

    case MOS6510_TYPE_LDX:
        cpu.x = getaddr(addr);
        setflags(MOS6510_FLAG_Z, !cpu.x);
        setflags(MOS6510_FLAG_N, cpu.x & 0x80);
        break;

    case MOS6510_TYPE_LDY:
        cpu.y = getaddr(addr);
        setflags(MOS6510_FLAG_Z, !cpu.y);
        setflags(MOS6510_FLAG_N, cpu.y&0x80);
        break;

    case MOS6510_TYPE_LSR:
        bval = getaddr(addr);
        wval = (uint8_t)bval;
        wval >>= 1;
        setaddr(addr, (uint8_t)wval);
        setflags(MOS6510_FLAG_Z, !wval);
        setflags(MOS6510_FLAG_N, wval & 0x80);
        setflags(MOS6510_FLAG_C, bval & 1);
        break;

    case MOS6510_TYPE_NOP:
        break;

    case MOS6510_TYPE_ORA:
        bval = getaddr(addr);
        cpu.a |= bval;
        setflags(MOS6510_FLAG_Z, !cpu.a);
        setflags(MOS6510_FLAG_N, cpu.a & 0x80);
        break;

    case MOS6510_TYPE_PHA:
        push(cpu.a);
        break;
    case MOS6510_TYPE_PHP:
        push(cpu.p);
        break;
    case MOS6510_TYPE_PLA:
        cpu.a=pop();
        setflags(MOS6510_FLAG_Z,!cpu.a);
        setflags(MOS6510_FLAG_N,cpu.a&0x80);
        break;
    case MOS6510_TYPE_PLP:
        cpu.p=pop();
        break;
    case MOS6510_TYPE_ROL:
        bval = getaddr(addr);
        c = !!(cpu.p & MOS6510_FLAG_C);
        setflags(MOS6510_FLAG_C, bval & 0x80);
        bval <<= 1;
        bval |= c;
        setaddr(addr, bval);
        setflags(MOS6510_FLAG_N, bval & 0x80);
        setflags(MOS6510_FLAG_Z,!bval);
        break;

    case MOS6510_TYPE_ROR:
        bval = getaddr(addr);
        c = !!(cpu.p&MOS6510_FLAG_C);
        setflags(MOS6510_FLAG_C, bval & 1);
        bval >>= 1;
        bval |= 128 * c;
        setaddr(addr, bval);
        setflags(MOS6510_FLAG_N, bval & 0x80);
        setflags(MOS6510_FLAG_Z, !bval);
        break;

    case MOS6510_TYPE_RTI:
        /* Treat RTI like RTS */
    case MOS6510_TYPE_RTS:
        wval = pop();
        wval |= pop() << 8;
        cpu.pc = wval + 1;
        break;

    case MOS6510_TYPE_SBC:
        bval = getaddr(addr) ^ 0xff;
        wval=(uint16_t)cpu.a + bval + ((cpu.p & MOS6510_FLAG_C) ? 1 : 0);
        setflags(MOS6510_FLAG_C, wval & 0x100);
        cpu.a = (uint8_t)wval;
        setflags(MOS6510_FLAG_Z, !cpu.a);
        setflags(MOS6510_FLAG_N, cpu.a > 127);
        setflags(MOS6510_FLAG_V, (!!(cpu.p & MOS6510_FLAG_C)) ^ (!!(cpu.p & MOS6510_FLAG_N)));
        break;

    case MOS6510_TYPE_SEC:
        setflags(MOS6510_FLAG_C, 1);
        break;

    case MOS6510_TYPE_SED:
        setflags(MOS6510_FLAG_D, 1);
        break;

    case MOS6510_TYPE_SEI:
        setflags(MOS6510_FLAG_I, 1);
        break;

    case MOS6510_TYPE_STA:
        putaddr(addr, cpu.a);
        break;

    case MOS6510_TYPE_STX:
        putaddr(addr, cpu.x);
        break;

    case MOS6510_TYPE_STY:
        putaddr(addr, cpu.y);
        break;

    case MOS6510_TYPE_TAX:
        cpu.x = cpu.a;
        setflags(MOS6510_FLAG_Z, !cpu.x);
        setflags(MOS6510_FLAG_N, cpu.x & 0x80);
        break;

    case MOS6510_TYPE_TAY:
        cpu.y = cpu.a;
        setflags(MOS6510_FLAG_Z, !cpu.y);
        setflags(MOS6510_FLAG_N, cpu.y & 0x80);
        break;

    case MOS6510_TYPE_TSX:
        cpu.x = cpu.s;
        setflags(MOS6510_FLAG_Z, !cpu.x);
        setflags(MOS6510_FLAG_N, cpu.x & 0x80);
        break;

    case MOS6510_TYPE_TXA:
        cpu.a = cpu.x;
        setflags(MOS6510_FLAG_Z, !cpu.a);
        setflags(MOS6510_FLAG_N, cpu.a & 0x80);
        break;

    case MOS6510_TYPE_TXS:
        cpu.s = cpu.x;
        break;

    case MOS6510_TYPE_TYA:
        cpu.a = cpu.y;
        setflags(MOS6510_FLAG_Z, !cpu.a);
        setflags(MOS6510_FLAG_N, cpu.a & 0x80);
        break;

  }
}

void c64_cpu_jsr(uint16_t new_pc, uint8_t new_a)
{
  cpu.a = new_a;
  cpu.x = 0x00;
  cpu.y = 0x00;
  cpu.p = 0x00;
  cpu.s = 0xFF;
  cpu.pc = new_pc;
  push(0);
  push(0);

  while (cpu.pc > 1)
    c64_cpu_step();
}

void c64_init()
{
  memset(memory, 0, sizeof(memory));

  c64_cpu_reset();
}

void c64_memcpy(uint16_t dest, const uint8_t* src, uint32_t size)
{
  if (dest + size < 64*1024) {
    memcpy(&memory[dest], src, size);
  }
}

void c64_memset(uint16_t dest, uint8_t val, uint32_t size)
{
  if (dest + size < 64*1024) {
    memset(&memory[dest], val, size);
  }
}
```

## src/c64.h
```c
/*
 * Copyright (c) 2020 Erwin Rol <erwin@erwinrol.com
 *
 * SPDX-License-Identifier: GPL-2.0-or-later
 */

#ifndef C64_H
#define C64_H

uint8_t c64_getmem(uint16_t addr);
void c64_setmem(uint16_t addr, uint8_t value);
void c64_cpu_jsr(uint16_t new_pc, uint8_t new_a);
void c64_init(void);
void c64_memcpy(uint16_t dest, const uint8_t* src, uint32_t size);
void c64_memset(uint16_t dest, uint8_t val, uint32_t size);

void c64_cpu_reset(void);
void c64_cpu_reset_to(uint16_t new_pc, uint8_t new_a);


#endif /* C64_H */
```

## src/mos6510.c
```c
/*
 * Copyright (c) 2020 Erwin Rol <erwin@erwinrol.com
 *
 * SPDX-License-Identifier: GPL-2.0-or-later
 */

#include "mos6510.h"

const struct mos6510_opcode mos6510_opcode_table[256] = {
  /* 0x00 */ {MOS6510_TYPE_BRK, MOS6510_MODE_IMP },
  /* 0x01 */ {MOS6510_TYPE_ORA, MOS6510_MODE_INDX },
  /* 0x02 */ {MOS6510_TYPE_XXX, MOS6510_MODE_XXX },
  /* 0x03 */ {MOS6510_TYPE_SLO, MOS6510_MODE_INDX },
  /* 0x04 */ {MOS6510_TYPE_NOP, MOS6510_MODE_ZP },
  /* 0x05 */ {MOS6510_TYPE_ORA, MOS6510_MODE_ZP },
  /* 0x06 */ {MOS6510_TYPE_ASL, MOS6510_MODE_ZP },
  /* 0x07 */ {MOS6510_TYPE_SLO, MOS6510_MODE_ZP },
  /* 0x08 */ {MOS6510_TYPE_PHP, MOS6510_MODE_IMP },
  /* 0x09 */ {MOS6510_TYPE_ORA, MOS6510_MODE_IMM },
  /* 0x0a */ {MOS6510_TYPE_ASL, MOS6510_MODE_ACC },
  /* 0x0b */ {MOS6510_TYPE_ANC, MOS6510_MODE_IMM },
  /* 0x0c */ {MOS6510_TYPE_NOP, MOS6510_MODE_ABS },
  /* 0x0d */ {MOS6510_TYPE_ORA, MOS6510_MODE_ABS },
  /* 0x0e */ {MOS6510_TYPE_ASL, MOS6510_MODE_ABS },
  /* 0x0f */ {MOS6510_TYPE_SLO, MOS6510_MODE_ABS },
  /* 0x10 */ {MOS6510_TYPE_BPL, MOS6510_MODE_REL },
  /* 0x11 */ {MOS6510_TYPE_ORA, MOS6510_MODE_INDY },
  /* 0x12 */ {MOS6510_TYPE_XXX, MOS6510_MODE_XXX },
  /* 0x13 */ {MOS6510_TYPE_SLO, MOS6510_MODE_INDY },
  /* 0x14 */ {MOS6510_TYPE_NOP, MOS6510_MODE_ZPX },
  /* 0x15 */ {MOS6510_TYPE_ORA, MOS6510_MODE_ZPX },
  /* 0x16 */ {MOS6510_TYPE_ASL, MOS6510_MODE_ZPX },
  /* 0x17 */ {MOS6510_TYPE_SLO, MOS6510_MODE_ZPX },
  /* 0x18 */ {MOS6510_TYPE_CLC, MOS6510_MODE_IMP },
  /* 0x19 */ {MOS6510_TYPE_ORA, MOS6510_MODE_ABSY },
  /* 0x1a */ {MOS6510_TYPE_NOP, MOS6510_MODE_ACC },
  /* 0x1b */ {MOS6510_TYPE_SLO, MOS6510_MODE_ABSY },
  /* 0x1c */ {MOS6510_TYPE_NOP, MOS6510_MODE_ABSX },
  /* 0x1d */ {MOS6510_TYPE_ORA, MOS6510_MODE_ABSX },
  /* 0x1e */ {MOS6510_TYPE_ASL, MOS6510_MODE_ABSX },
  /* 0x1f */ {MOS6510_TYPE_SLO, MOS6510_MODE_ABSX },
  /* 0x20 */ {MOS6510_TYPE_JSR, MOS6510_MODE_ABS },
  /* 0x21 */ {MOS6510_TYPE_AND, MOS6510_MODE_INDX },
  /* 0x22 */ {MOS6510_TYPE_XXX, MOS6510_MODE_XXX },
  /* 0x23 */ {MOS6510_TYPE_RLA, MOS6510_MODE_INDX },
  /* 0x24 */ {MOS6510_TYPE_BIT, MOS6510_MODE_ZP },
  /* 0x25 */ {MOS6510_TYPE_AND, MOS6510_MODE_ZP },
  /* 0x26 */ {MOS6510_TYPE_ROL, MOS6510_MODE_ZP },
  /* 0x27 */ {MOS6510_TYPE_RLA, MOS6510_MODE_ZP },
  /* 0x28 */ {MOS6510_TYPE_PLP, MOS6510_MODE_IMP },
  /* 0x29 */ {MOS6510_TYPE_AND, MOS6510_MODE_IMM },
  /* 0x2a */ {MOS6510_TYPE_ROL, MOS6510_MODE_ACC },
  /* 0x2b */ {MOS6510_TYPE_ANC, MOS6510_MODE_IMM },
  /* 0x2c */ {MOS6510_TYPE_BIT, MOS6510_MODE_ABS },
  /* 0x2d */ {MOS6510_TYPE_AND, MOS6510_MODE_ABS },
  /* 0x2e */ {MOS6510_TYPE_ROL, MOS6510_MODE_ABS },
  /* 0x2f */ {MOS6510_TYPE_RLA, MOS6510_MODE_ABS },
  /* 0x30 */ {MOS6510_TYPE_BMI, MOS6510_MODE_REL },
  /* 0x31 */ {MOS6510_TYPE_AND, MOS6510_MODE_INDY },
  /* 0x32 */ {MOS6510_TYPE_XXX, MOS6510_MODE_XXX },
  /* 0x33 */ {MOS6510_TYPE_RLA, MOS6510_MODE_INDY },
  /* 0x34 */ {MOS6510_TYPE_NOP, MOS6510_MODE_ZPX },
  /* 0x35 */ {MOS6510_TYPE_AND, MOS6510_MODE_ZPX },
  /* 0x36 */ {MOS6510_TYPE_ROL, MOS6510_MODE_ZPX },
  /* 0x37 */ {MOS6510_TYPE_RLA, MOS6510_MODE_ZPX },
  /* 0x38 */ {MOS6510_TYPE_SEC, MOS6510_MODE_IMP },
  /* 0x39 */ {MOS6510_TYPE_AND, MOS6510_MODE_ABSY },
  /* 0x3A */ {MOS6510_TYPE_NOP, MOS6510_MODE_ACC },
  /* 0x3B */ {MOS6510_TYPE_RLA, MOS6510_MODE_ABSY },
  /* 0x3C */ {MOS6510_TYPE_NOP, MOS6510_MODE_ABSX },
  /* 0x3D */ {MOS6510_TYPE_AND, MOS6510_MODE_ABSX },
  /* 0x3E */ {MOS6510_TYPE_ROL, MOS6510_MODE_ABSX },
  /* 0x3F */ {MOS6510_TYPE_RLA, MOS6510_MODE_ABSX },
  /* 0x40 */ {MOS6510_TYPE_RTI, MOS6510_MODE_IMP },
  /* 0x41 */ {MOS6510_TYPE_EOR, MOS6510_MODE_INDX },
  /* 0x42 */ {MOS6510_TYPE_XXX, MOS6510_MODE_XXX },
  /* 0x43 */ {MOS6510_TYPE_SRE, MOS6510_MODE_INDX },
  /* 0x44 */ {MOS6510_TYPE_NOP, MOS6510_MODE_ZP },
  /* 0x45 */ {MOS6510_TYPE_EOR, MOS6510_MODE_ZP },
  /* 0x46 */ {MOS6510_TYPE_LSR, MOS6510_MODE_ZP },
  /* 0x47 */ {MOS6510_TYPE_SRE, MOS6510_MODE_ZP },
  /* 0x48 */ {MOS6510_TYPE_PHA, MOS6510_MODE_IMP },
  /* 0x49 */ {MOS6510_TYPE_EOR, MOS6510_MODE_IMM },
  /* 0x4A */ {MOS6510_TYPE_LSR, MOS6510_MODE_ACC },
  /* 0x4B */ {MOS6510_TYPE_ALR, MOS6510_MODE_IMM },
  /* 0x4C */ {MOS6510_TYPE_JMP, MOS6510_MODE_ABS },
  /* 0x4D */ {MOS6510_TYPE_EOR, MOS6510_MODE_ABS },
  /* 0x4E */ {MOS6510_TYPE_LSR, MOS6510_MODE_ABS },
  /* 0x4F */ {MOS6510_TYPE_SRE, MOS6510_MODE_ABS },
  /* 0x50 */ {MOS6510_TYPE_BVC, MOS6510_MODE_REL },
  /* 0x51 */ {MOS6510_TYPE_EOR, MOS6510_MODE_INDY },
  /* 0x52 */ {MOS6510_TYPE_XXX, MOS6510_MODE_XXX },
  /* 0x53 */ {MOS6510_TYPE_SRE, MOS6510_MODE_INDY },
  /* 0x54 */ {MOS6510_TYPE_NOP, MOS6510_MODE_ZPX },
  /* 0x55 */ {MOS6510_TYPE_EOR, MOS6510_MODE_ZPX },
  /* 0x56 */ {MOS6510_TYPE_LSR, MOS6510_MODE_ZPX },
  /* 0x57 */ {MOS6510_TYPE_SRE, MOS6510_MODE_ZPX },
  /* 0x58 */ {MOS6510_TYPE_CLI, MOS6510_MODE_IMP },
  /* 0x59 */ {MOS6510_TYPE_EOR, MOS6510_MODE_ABSY },
  /* 0x5A */ {MOS6510_TYPE_NOP, MOS6510_MODE_ACC },
  /* 0x5B */ {MOS6510_TYPE_SRE, MOS6510_MODE_ABSY },
  /* 0x5C */ {MOS6510_TYPE_NOP, MOS6510_MODE_ABSX },
  /* 0x5D */ {MOS6510_TYPE_EOR, MOS6510_MODE_ABSX },
  /* 0x5E */ {MOS6510_TYPE_LSR, MOS6510_MODE_ABSX },
  /* 0x5F */ {MOS6510_TYPE_SRE, MOS6510_MODE_ABSX },
  /* 0x60 */ {MOS6510_TYPE_RTS, MOS6510_MODE_IMP },
  /* 0x61 */ {MOS6510_TYPE_ADC, MOS6510_MODE_INDX },
  /* 0x62 */ {MOS6510_TYPE_XXX, MOS6510_MODE_XXX },
  /* 0x63 */ {MOS6510_TYPE_RRA, MOS6510_MODE_INDX },
  /* 0x64 */ {MOS6510_TYPE_NOP, MOS6510_MODE_ZP },
  /* 0x65 */ {MOS6510_TYPE_ADC, MOS6510_MODE_ZP },
  /* 0x66 */ {MOS6510_TYPE_ROR, MOS6510_MODE_ZP },
  /* 0x67 */ {MOS6510_TYPE_RRA, MOS6510_MODE_ZP },
  /* 0x68 */ {MOS6510_TYPE_PLA, MOS6510_MODE_IMP },
  /* 0x69 */ {MOS6510_TYPE_ADC, MOS6510_MODE_IMM },
  /* 0x6A */ {MOS6510_TYPE_ROR, MOS6510_MODE_ACC },
  /* 0x6B */ {MOS6510_TYPE_ARR, MOS6510_MODE_IMM },
  /* 0x6C */ {MOS6510_TYPE_JMP, MOS6510_MODE_IND },
  /* 0x6D */ {MOS6510_TYPE_ADC, MOS6510_MODE_ABS },
  /* 0x6E */ {MOS6510_TYPE_ROR, MOS6510_MODE_ABS },
  /* 0x6F */ {MOS6510_TYPE_RRA, MOS6510_MODE_ABS },
  /* 0x70 */ {MOS6510_TYPE_BVS, MOS6510_MODE_REL },
  /* 0x71 */ {MOS6510_TYPE_ADC, MOS6510_MODE_INDY },
  /* 0x72 */ {MOS6510_TYPE_XXX, MOS6510_MODE_XXX },
  /* 0x73 */ {MOS6510_TYPE_RRA, MOS6510_MODE_INDY },
  /* 0x74 */ {MOS6510_TYPE_NOP, MOS6510_MODE_ZPX },
  /* 0x75 */ {MOS6510_TYPE_ADC, MOS6510_MODE_ZPX },
  /* 0x76 */ {MOS6510_TYPE_ROR, MOS6510_MODE_ZPX },
  /* 0x77 */ {MOS6510_TYPE_RRA, MOS6510_MODE_ZPX },
  /* 0x78 */ {MOS6510_TYPE_SEI, MOS6510_MODE_IMP },
  /* 0x79 */ {MOS6510_TYPE_ADC, MOS6510_MODE_ABSY },
  /* 0x7A */ {MOS6510_TYPE_NOP, MOS6510_MODE_ACC },
  /* 0x7B */ {MOS6510_TYPE_RRA, MOS6510_MODE_ABSY },
  /* 0x7C */ {MOS6510_TYPE_NOP, MOS6510_MODE_ABSX },
  /* 0x7D */ {MOS6510_TYPE_ADC, MOS6510_MODE_ABSX },
  /* 0x7E */ {MOS6510_TYPE_ROR, MOS6510_MODE_ABSX },
  /* 0x7F */ {MOS6510_TYPE_RRA, MOS6510_MODE_ABSX },
  /* 0x80 */ {MOS6510_TYPE_NOP, MOS6510_MODE_IMM },
  /* 0x81 */ {MOS6510_TYPE_STA, MOS6510_MODE_INDX },
  /* 0x82 */ {MOS6510_TYPE_NOP, MOS6510_MODE_IMM },
  /* 0x83 */ {MOS6510_TYPE_SAX, MOS6510_MODE_INDX },
  /* 0x84 */ {MOS6510_TYPE_STY, MOS6510_MODE_ZP },
  /* 0x85 */ {MOS6510_TYPE_STA, MOS6510_MODE_ZP },
  /* 0x86 */ {MOS6510_TYPE_STX, MOS6510_MODE_ZP },
  /* 0x87 */ {MOS6510_TYPE_SAX, MOS6510_MODE_ZP },
  /* 0x88 */ {MOS6510_TYPE_DEY, MOS6510_MODE_IMP },
  /* 0x89 */ {MOS6510_TYPE_NOP, MOS6510_MODE_IMM },
  /* 0x8A */ {MOS6510_TYPE_TXA, MOS6510_MODE_ACC },
  /* 0x8B */ {MOS6510_TYPE_XAA, MOS6510_MODE_IMM },
  /* 0x8C */ {MOS6510_TYPE_STY, MOS6510_MODE_ABS },
  /* 0x8D */ {MOS6510_TYPE_STA, MOS6510_MODE_ABS },
  /* 0x8E */ {MOS6510_TYPE_STX, MOS6510_MODE_ABS },
  /* 0x8F */ {MOS6510_TYPE_SAX, MOS6510_MODE_ABS },
  /* 0x90 */ {MOS6510_TYPE_BCC, MOS6510_MODE_REL },
  /* 0x91 */ {MOS6510_TYPE_STA, MOS6510_MODE_INDY },
  /* 0x92 */ {MOS6510_TYPE_XXX, MOS6510_MODE_XXX },
  /* 0x93 */ {MOS6510_TYPE_AHX, MOS6510_MODE_INDY },
  /* 0x94 */ {MOS6510_TYPE_STY, MOS6510_MODE_ZPX },
  /* 0x95 */ {MOS6510_TYPE_STA, MOS6510_MODE_ZPX },
  /* 0x96 */ {MOS6510_TYPE_STX, MOS6510_MODE_ZPY },
  /* 0x97 */ {MOS6510_TYPE_SAX, MOS6510_MODE_ZPY },
  /* 0x98 */ {MOS6510_TYPE_TYA, MOS6510_MODE_IMP },
  /* 0x99 */ {MOS6510_TYPE_STA, MOS6510_MODE_ABSY },
  /* 0x9A */ {MOS6510_TYPE_TXS, MOS6510_MODE_ACC },
  /* 0x9B */ {MOS6510_TYPE_TAS, MOS6510_MODE_ABSY },
  /* 0x9C */ {MOS6510_TYPE_SHY, MOS6510_MODE_ABSX },
  /* 0x9D */ {MOS6510_TYPE_STA, MOS6510_MODE_ABSX },
  /* 0x9E */ {MOS6510_TYPE_SHX, MOS6510_MODE_ABSY },
  /* 0x9F */ {MOS6510_TYPE_AHX, MOS6510_MODE_ABSY },
  /* 0xA0 */ {MOS6510_TYPE_LDY, MOS6510_MODE_IMM },
  /* 0xA1 */ {MOS6510_TYPE_LDA, MOS6510_MODE_INDX },
  /* 0xA2 */ {MOS6510_TYPE_LDX, MOS6510_MODE_IMM },
  /* 0xA3 */ {MOS6510_TYPE_LAX, MOS6510_MODE_INDX },
  /* 0xA4 */ {MOS6510_TYPE_LDY, MOS6510_MODE_ZP },
  /* 0xA5 */ {MOS6510_TYPE_LDA, MOS6510_MODE_ZP },
  /* 0xA6 */ {MOS6510_TYPE_LDX, MOS6510_MODE_ZP },
  /* 0xA7 */ {MOS6510_TYPE_LAX, MOS6510_MODE_ZP },
  /* 0xA8 */ {MOS6510_TYPE_TAY, MOS6510_MODE_IMP },
  /* 0xA9 */ {MOS6510_TYPE_LDA, MOS6510_MODE_IMM },
  /* 0xAA */ {MOS6510_TYPE_TAX, MOS6510_MODE_ACC },
  /* 0xAB */ {MOS6510_TYPE_LAX, MOS6510_MODE_IMM },
  /* 0xAC */ {MOS6510_TYPE_LDY, MOS6510_MODE_ABS },
  /* 0xAD */ {MOS6510_TYPE_LDA, MOS6510_MODE_ABS },
  /* 0xAE */ {MOS6510_TYPE_LDX, MOS6510_MODE_ABS },
  /* 0xAF */ {MOS6510_TYPE_LAX, MOS6510_MODE_ABS },
  /* 0xB0 */ {MOS6510_TYPE_BCS, MOS6510_MODE_REL },
  /* 0xB1 */ {MOS6510_TYPE_LDA, MOS6510_MODE_INDY },
  /* 0xB2 */ {MOS6510_TYPE_XXX, MOS6510_MODE_XXX },
  /* 0xB3 */ {MOS6510_TYPE_LAX, MOS6510_MODE_INDY },
  /* 0xB4 */ {MOS6510_TYPE_LDY, MOS6510_MODE_ZPX },
  /* 0xB5 */ {MOS6510_TYPE_LDA, MOS6510_MODE_ZPX },
  /* 0xB6 */ {MOS6510_TYPE_LDX, MOS6510_MODE_ZPY },
  /* 0xB7 */ {MOS6510_TYPE_LAX, MOS6510_MODE_ZPY },
  /* 0xB8 */ {MOS6510_TYPE_CLV, MOS6510_MODE_IMP },
  /* 0xB9 */ {MOS6510_TYPE_LDA, MOS6510_MODE_ABSY },
  /* 0xBA */ {MOS6510_TYPE_TSX, MOS6510_MODE_ACC },
  /* 0xBB */ {MOS6510_TYPE_LAS, MOS6510_MODE_ABSY },
  /* 0xBC */ {MOS6510_TYPE_LDY, MOS6510_MODE_ABSX },
  /* 0xBD */ {MOS6510_TYPE_LDA, MOS6510_MODE_ABSX },
  /* 0xBE */ {MOS6510_TYPE_LDX, MOS6510_MODE_ABSY },
  /* 0xBF */ {MOS6510_TYPE_LAX, MOS6510_MODE_ABSY },
  /* 0xC0 */ {MOS6510_TYPE_CPY, MOS6510_MODE_IMM },
  /* 0xC1 */ {MOS6510_TYPE_CMP, MOS6510_MODE_INDX },
  /* 0xC2 */ {MOS6510_TYPE_NOP, MOS6510_MODE_IMM },
  /* 0xC3 */ {MOS6510_TYPE_DCP, MOS6510_MODE_INDX },
  /* 0xC4 */ {MOS6510_TYPE_CPY, MOS6510_MODE_ZP },
  /* 0xC5 */ {MOS6510_TYPE_CMP, MOS6510_MODE_ZP },
  /* 0xC6 */ {MOS6510_TYPE_DEC, MOS6510_MODE_ZP },
  /* 0xC7 */ {MOS6510_TYPE_DCP, MOS6510_MODE_ZP },
  /* 0xC8 */ {MOS6510_TYPE_INY, MOS6510_MODE_IMP },
  /* 0xC9 */ {MOS6510_TYPE_CMP, MOS6510_MODE_IMM },
  /* 0xCA */ {MOS6510_TYPE_DEX, MOS6510_MODE_ACC },
  /* 0xCB */ {MOS6510_TYPE_AXS, MOS6510_MODE_IMM },
  /* 0xCC */ {MOS6510_TYPE_CPY, MOS6510_MODE_ABS },
  /* 0xCD */ {MOS6510_TYPE_CMP, MOS6510_MODE_ABS },
  /* 0xCE */ {MOS6510_TYPE_DEC, MOS6510_MODE_ABS },
  /* 0xCF */ {MOS6510_TYPE_DCP, MOS6510_MODE_ABS },
  /* 0xD0 */ {MOS6510_TYPE_BNE, MOS6510_MODE_REL },
  /* 0xD1 */ {MOS6510_TYPE_CMP, MOS6510_MODE_INDY },
  /* 0xD2 */ {MOS6510_TYPE_XXX, MOS6510_MODE_XXX },
  /* 0xD3 */ {MOS6510_TYPE_DCP, MOS6510_MODE_INDY },
  /* 0xD4 */ {MOS6510_TYPE_NOP, MOS6510_MODE_ZPX },
  /* 0xD5 */ {MOS6510_TYPE_CMP, MOS6510_MODE_ZPX },
  /* 0xD6 */ {MOS6510_TYPE_DEC, MOS6510_MODE_ZPX },
  /* 0xD7 */ {MOS6510_TYPE_DCP, MOS6510_MODE_ZPX },
  /* 0xD8 */ {MOS6510_TYPE_CLD, MOS6510_MODE_IMP },
  /* 0xD9 */ {MOS6510_TYPE_CMP, MOS6510_MODE_ABSY },
  /* 0xDA */ {MOS6510_TYPE_NOP, MOS6510_MODE_ACC },
  /* 0xDB */ {MOS6510_TYPE_DCP, MOS6510_MODE_ABSY },
  /* 0xDC */ {MOS6510_TYPE_NOP, MOS6510_MODE_ABSX },
  /* 0xDD */ {MOS6510_TYPE_CMP, MOS6510_MODE_ABSX },
  /* 0xDE */ {MOS6510_TYPE_DEC, MOS6510_MODE_ABSX },
  /* 0xDF */ {MOS6510_TYPE_DCP, MOS6510_MODE_ABSX },
  /* 0xE0 */ {MOS6510_TYPE_CPX, MOS6510_MODE_IMM },
  /* 0xE1 */ {MOS6510_TYPE_SBC, MOS6510_MODE_INDX },
  /* 0xE2 */ {MOS6510_TYPE_NOP, MOS6510_MODE_IMM },
  /* 0xE3 */ {MOS6510_TYPE_ISC, MOS6510_MODE_INDX },
  /* 0xE4 */ {MOS6510_TYPE_CPX, MOS6510_MODE_ZP },
  /* 0xE5 */ {MOS6510_TYPE_SBC, MOS6510_MODE_ZP },
  /* 0xE6 */ {MOS6510_TYPE_INC, MOS6510_MODE_ZP },
  /* 0xE7 */ {MOS6510_TYPE_ISC, MOS6510_MODE_ZP },
  /* 0xE8 */ {MOS6510_TYPE_INX, MOS6510_MODE_IMP },
  /* 0xE9 */ {MOS6510_TYPE_SBC, MOS6510_MODE_IMM },
  /* 0xEA */ {MOS6510_TYPE_NOP, MOS6510_MODE_ACC },
  /* 0xEB */ {MOS6510_TYPE_SBC, MOS6510_MODE_IMM },
  /* 0xEC */ {MOS6510_TYPE_CPX, MOS6510_MODE_ABS },
  /* 0xED */ {MOS6510_TYPE_SBC, MOS6510_MODE_ABS },
  /* 0xEE */ {MOS6510_TYPE_INC, MOS6510_MODE_ABS },
  /* 0xEF */ {MOS6510_TYPE_ISC, MOS6510_MODE_ABS },
  /* 0xF0 */ {MOS6510_TYPE_BEQ, MOS6510_MODE_REL },
  /* 0xF1 */ {MOS6510_TYPE_SBC, MOS6510_MODE_INDY },
  /* 0xF2 */ {MOS6510_TYPE_XXX, MOS6510_MODE_XXX },
  /* 0xF3 */ {MOS6510_TYPE_ISC, MOS6510_MODE_INDY },
  /* 0xF4 */ {MOS6510_TYPE_NOP, MOS6510_MODE_ZPX },
  /* 0xF5 */ {MOS6510_TYPE_SBC, MOS6510_MODE_ZPX },
  /* 0xF6 */ {MOS6510_TYPE_INC, MOS6510_MODE_ZPX },
  /* 0xF7 */ {MOS6510_TYPE_ISC, MOS6510_MODE_ZPX },
  /* 0xF8 */ {MOS6510_TYPE_SED, MOS6510_MODE_IMP },
  /* 0xF9 */ {MOS6510_TYPE_SBC, MOS6510_MODE_ABSY },
  /* 0xFA */ {MOS6510_TYPE_NOP, MOS6510_MODE_ACC },
  /* 0xFB */ {MOS6510_TYPE_ISC, MOS6510_MODE_ABSY },
  /* 0xFC */ {MOS6510_TYPE_NOP, MOS6510_MODE_ABSX },
  /* 0xFD */ {MOS6510_TYPE_SBC, MOS6510_MODE_ABSX },
  /* 0xFE */ {MOS6510_TYPE_INC, MOS6510_MODE_ABSX },
  /* 0xFF */ {MOS6510_TYPE_ISC, MOS6510_MODE_ABSX },
};
```

## src/mos6510.h
```c
/*
 * Copyright (c) 2020 Erwin Rol <erwin@erwinrol.com
 *
 * SPDX-License-Identifier: GPL-2.0-or-later
 */

#ifndef MOS6510_H
#define MOS6510_H

#include <stdint.h>

#define MOS6510_FLAG_N  128
#define MOS6510_FLAG_V  64
#define MOS6510_FLAG_B  16
#define MOS6510_FLAG_D  8
#define MOS6510_FLAG_I  4
#define MOS6510_FLAG_Z  2
#define MOS6510_FLAG_C  1

#define MOS6510_MODE_IMP  0
#define MOS6510_MODE_IMM  1
#define MOS6510_MODE_ABS  2
#define MOS6510_MODE_ABSX 3
#define MOS6510_MODE_ABSY 4
#define MOS6510_MODE_ZP   6
#define MOS6510_MODE_ZPX  7
#define MOS6510_MODE_ZPY  8
#define MOS6510_MODE_IND  9
#define MOS6510_MODE_INDX 10
#define MOS6510_MODE_INDY 11
#define MOS6510_MODE_ACC  12
#define MOS6510_MODE_REL  13
#define MOS6510_MODE_XXX  14

#define MOS6510_TYPE_ADC  0
#define MOS6510_TYPE_AND  1
#define MOS6510_TYPE_ASL  2
#define MOS6510_TYPE_BCC  3
#define MOS6510_TYPE_BCS  4
#define MOS6510_TYPE_BEQ  5
#define MOS6510_TYPE_BIT  6
#define MOS6510_TYPE_BMI  7
#define MOS6510_TYPE_BNE  8
#define MOS6510_TYPE_BPL  9
#define MOS6510_TYPE_BRK  10
#define MOS6510_TYPE_BVC  11
#define MOS6510_TYPE_BVS  12
#define MOS6510_TYPE_CLC  13
#define MOS6510_TYPE_CLD  14
#define MOS6510_TYPE_CLI  15
#define MOS6510_TYPE_CLV  16
#define MOS6510_TYPE_CMP  17
#define MOS6510_TYPE_CPX  18
#define MOS6510_TYPE_CPY  19
#define MOS6510_TYPE_DEC  20
#define MOS6510_TYPE_DEX  21
#define MOS6510_TYPE_DEY  22
#define MOS6510_TYPE_EOR  23
#define MOS6510_TYPE_INC  24
#define MOS6510_TYPE_INX  25
#define MOS6510_TYPE_INY  26
#define MOS6510_TYPE_JMP  27
#define MOS6510_TYPE_JSR  28
#define MOS6510_TYPE_LDA  29
#define MOS6510_TYPE_LDX  30
#define MOS6510_TYPE_LDY  31
#define MOS6510_TYPE_LSR  32
#define MOS6510_TYPE_NOP  33
#define MOS6510_TYPE_ORA  34
#define MOS6510_TYPE_PHA  35
#define MOS6510_TYPE_PHP  36
#define MOS6510_TYPE_PLA  37
#define MOS6510_TYPE_PLP  38
#define MOS6510_TYPE_ROL  39
#define MOS6510_TYPE_ROR  40
#define MOS6510_TYPE_RTI  41
#define MOS6510_TYPE_RTS  42
#define MOS6510_TYPE_SBC  43
#define MOS6510_TYPE_SEC  44
#define MOS6510_TYPE_SED  45
#define MOS6510_TYPE_SEI  46
#define MOS6510_TYPE_STA  47
#define MOS6510_TYPE_STX  48
#define MOS6510_TYPE_STY  49
#define MOS6510_TYPE_TAX  50
#define MOS6510_TYPE_TAY  51
#define MOS6510_TYPE_TSX  52
#define MOS6510_TYPE_TXA  53
#define MOS6510_TYPE_TXS  54
#define MOS6510_TYPE_TYA  55
#define MOS6510_TYPE_XXX  56

#define MOS6510_TYPE_SLO  57
#define MOS6510_TYPE_ANC  58
#define MOS6510_TYPE_RLA  59
#define MOS6510_TYPE_SRE  60
#define MOS6510_TYPE_ALR  61
#define MOS6510_TYPE_RRA  62
#define MOS6510_TYPE_ARR  63
#define MOS6510_TYPE_SAX  64
#define MOS6510_TYPE_XAA  65
#define MOS6510_TYPE_AHX  66
#define MOS6510_TYPE_TAS  67
#define MOS6510_TYPE_SHY  68
#define MOS6510_TYPE_SHX  69
#define MOS6510_TYPE_LAX  70
#define MOS6510_TYPE_LAS  71
#define MOS6510_TYPE_DCP  72
#define MOS6510_TYPE_AXS  73
#define MOS6510_TYPE_ISC  74

struct mos6510 {
  uint8_t a;
  uint8_t x;
  uint8_t y;
  uint8_t s;
  uint8_t p;
  uint16_t pc;
};

struct mos6510_opcode {
  uint8_t type;
  uint8_t mode;
};

extern const struct mos6510_opcode mos6510_opcode_table[256];

#endif /* MOS6510_H */
```

## src/sid.c
```c
/*
 * Copyright (c) 2020 Erwin Rol <erwin@erwinrol.com
 *
 * SPDX-License-Identifier: GPL-2.0-or-later
 */

#include "sid.h"
#include "c64.h"
#include "sid_spi.h"

#include <string.h>
#include <stdlib.h>
#include <stdint.h>


void sid_poke(uint16_t reg, uint8_t val)
{
  uint8_t status;
  uint8_t rd_data;

  sid_spi_transfer(0x80 | reg, val, &status, &rd_data);
}

bool sid_load_from_memory(const uint8_t* data, size_t size, struct sid_info *info)
{
  if (!data || !size || !info)
    return false;

  unsigned char data_file_offset;

  data_file_offset = data[7];

  info->load_addr = data[8]<<8;
  info->load_addr|= data[9];

  info->init_addr = data[10]<<8;
  info->init_addr|= data[11];

  info->play_addr = data[12]<<8;
  info->play_addr|= data[13];

  info->subsongs = data[0xf]-1;
  info->start_song = data[0x11]-1;

  info->load_addr = data[data_file_offset];
  info->load_addr|= data[data_file_offset + 1] << 8;

  info->speed = data[0x15];

  c64_memset(0, 0, 64 * 1024);
  c64_memcpy(info->load_addr, &data[data_file_offset+2], size-(data_file_offset+2));

  strcpy(info->title, (const char*)&data[0x16]);
  strcpy(info->author, (const char*)&data[0x36]);
  strcpy(info->released, (const char*)&data[0x56]);

  if (info->play_addr == 0)
  {
    c64_cpu_jsr(info->init_addr, 0);
    info->play_addr = (c64_getmem(0x0315) << 8) | c64_getmem(0x0314);
  }

  return true;
}
```

## src/sid.h
```c
/*
 * Copyright (c) 2020 Erwin Rol <erwin@erwinrol.com
 *
 * SPDX-License-Identifier: GPL-2.0-or-later
 */

#ifndef SID_H
#define SID_H

#include <stdint.h>
#include <stdbool.h>
#include <stddef.h>

void sid_poke(uint16_t reg, uint8_t val);

struct sid_info
{
    uint16_t load_addr;
    uint16_t init_addr;
    uint16_t play_addr;
    uint8_t  subsongs;
    uint8_t  start_song;
    uint8_t  speed;
    char     title[32];
    char     author[32];
    char     released[32];
};

bool sid_load_from_memory(const uint8_t* data, size_t size, struct sid_info* info);

#endif /* SID_H */
```

## src/sid_file.c
```c
/*
 * Copyright (c) 2020 Erwin Rol <erwin@erwinrol.com
 *
 * SPDX-License-Identifier: GPL-2.0-or-later
 */

#include "sid_file.h"

const uint8_t sid_file_data[] = {
#include "big_fun_tune_5.hex"
};

const uint8_t* sid_file = sid_file_data;
const uint16_t sid_file_size = sizeof(sid_file_data);
```

## src/sid_file.h
```c
/*
 * Copyright (c) 2020 Erwin Rol <erwin@erwinrol.com
 *
 * SPDX-License-Identifier: GPL-2.0-or-later
 */

#ifndef SID_FILE_H
#define SID_FILE_H

#include <stdint.h>

extern const uint8_t* sid_file;
extern const uint16_t sid_file_size;

#endif /* SID_FILE_H */
```

## src/sid_spi.c
```c
/*
 * Copyright (c) 2020 Erwin Rol <erwin@erwinrol.com
 *
 * SPDX-License-Identifier: GPL-2.0-or-later
 */

#include "sid_spi.h"

#include <errno.h>
#include <zephyr.h>
#include <sys/printk.h>
#include <device.h>
#include <drivers/spi.h>
#include <soc.h>

static const struct device *gpioa;
static const struct device *gpiob;
static const struct device *gpioc;

static const struct device *spi;

static struct spi_config       spi_cfg;
static struct spi_cs_control   spi_cs;

void sid_spi_transfer( uint8_t cmd_addr, uint8_t wr_data,
                       uint8_t* status, uint8_t* rd_data)
{
  int res;

  uint8_t wr_buffer[2];
  uint8_t rd_buffer[2];

  wr_buffer[0] = cmd_addr;
  wr_buffer[1] = wr_data;

  struct spi_buf wr_bufs[] = {
    {
      .buf = &wr_buffer,
      .len = 2,
    },
  };

  struct spi_buf rd_bufs[] = {
    {
      .buf = rd_buffer,
      .len = 2,
    },
  };

  struct spi_buf_set tx = {
    .buffers = wr_bufs,
    .count = 1,
  };

  struct spi_buf_set rx = {
    .buffers = rd_bufs,
    .count = 1,
  };

  res = spi_transceive(spi, &spi_cfg, &tx, &rx);

  *status = rd_buffer[0];
  *rd_data = rd_buffer[1];
}

int sid_spi_init(void)
{
  int err;

  gpioa = device_get_binding("GPIOA");
  if (!gpioa) {
    return -1;
  }

  gpiob = device_get_binding("GPIOB");
  if (!gpiob) {
    return -1;
  }

  gpioc = device_get_binding("GPIOC");
  if (!gpioc) {
    return -1;
  }

  gpio_pin_configure(gpioc, 7, GPIO_OUTPUT | GPIO_ACTIVE_LOW);
  gpio_pin_set_raw(gpioc, 7, 1);

  gpio_pin_configure(gpioa, 9, GPIO_OUTPUT | GPIO_ACTIVE_LOW);
  gpio_pin_set_raw(gpioa, 9, 1);

  gpio_pin_configure(gpiob, 6, GPIO_OUTPUT | GPIO_ACTIVE_LOW);
  gpio_pin_set_raw(gpiob, 6, 1);

  spi = device_get_binding("SPI_1");
  if (!spi) {
    return -1;
  }

  spi_cs.delay = 0;
  spi_cs.gpio_dev = gpiob;
  spi_cs.gpio_pin = 6;
  spi_cs.gpio_dt_flags = GPIO_ACTIVE_LOW;

  spi_cfg.slave = 0;
  spi_cfg.operation = SPI_OP_MODE_MASTER | SPI_WORD_SET(8);
  spi_cfg.frequency = 10000000U;
  spi_cfg.cs = &spi_cs;

  return 0;
}
```

## src/sid_spi.h
```c
/*
 * Copyright (c) 2020 Erwin Rol <erwin@erwinrol.com
 *
 * SPDX-License-Identifier: GPL-2.0-or-later
 */

#ifndef SID_SPI_H
#define SID_SPI_H

#include <stdint.h>

void sid_spi_transfer( uint8_t cmd_addr, uint8_t wr_data,
                       uint8_t* status, uint8_t* rd_data);
int sid_spi_init(void);

#endif /* SID_SPI_H */
```
